## drivers/power/supply/qcom/Kconfig
```kconfig
# SPDX-License-Identifier: GPL-2.0-only

menuconfig QCOM_POWER_SUPPLY
	bool "Support for Qualcomm Technologies, Inc. power supply"
	depends on ARCH_QCOM
	help
	  Say Y here to enable Qualcomm Technologies, Inc. specific
	  power supply drivers. This allows adding support for various
	  charging peripherals and battery management features.
	  (if selected below).

if QCOM_POWER_SUPPLY

config QPNP_QG
	tristate "QPNP Qgauge driver"
	depends on MFD_SPMI_PMIC
	depends on IIO
	help
	  Say Y here to enable the Qualcomm Technologies, Inc. QGauge driver
	  which uses the periodic sampling of the battery voltage and current
	  to determine the battery state-of-charge (SOC) and supports other
	  battery management features.

	  To compile this driver as a module, choose M here: the
	  module will be called qcom-qpnp-qg.

config QPNP_SMB5
	tristate "SMB5 Battery Charger"
	depends on MFD_SPMI_PMIC && IIO && TYPEC
	help
	  Say Y to enables support for the SMB5 charging peripheral.
	  The QPNP SMB5 charger driver supports the charger peripheral
	  present in the chip.
	  The power supply and iio frameworks are used to communicate battery
	  and usb properties to userspace and other driver consumers such
	  as fuel gauge, USB, and USB-PD.
	  VBUS and VCONN regulators are registered for supporting OTG,
	  and powered Type-C cables respectively.

	  To compile this driver as a module, choose M here: the
	  module will be called qpnp-smb5-main.

config QPNP_SMBLITE
	tristate "SMBLITE Battery Charger"
	depends on MFD_SPMI_PMIC
	help
	 Say Y to enable support for the SMBLITE charging peripheral.
	 The QPNP SMBLITE charger driver supports the charger peripheral
	 present in the chip.
	 The power supply framework is used to communicate battery and
	 usb properties to userspace and other driver consumers such
	 as fuel gauge and USB.
	 VBUS regulator is registered for supporting OTG.

config SMB1390_CHARGE_PUMP_PSY
	tristate "SMB1390 power supply framework based driver"
	depends on MFD_I2C_PMIC && IIO
	help
	  Say Y to include support for SMB1390 Charge Pump driver based on
	  power supply framework.
	  SMB1390 is a div2 charge pump capable of delivering 6A charge current
	  with very high efficiency. It can work either as 2s to 1s pre-regulator
	  or as a companion charger when paired with Qualcomm Technologies, Inc.’s
	  family of standalone chargers to enable a high current, low profile
	  Li+ battery charging system.

config QTI_QBG
        tristate "QTI Battery Gauge"
        depends on MFD_SPMI_PMIC && IIO
        help
          Say Y here to enable the Qualcomm Technologies, Inc. Battery Gauge
          driver which uses the periodic samples of the battery voltage and
          current to determine the battery state-of-charge (SOC) and supports
          other battery management features.

          To compile this driver as a module, choose M here: the
          module will be called qti-qbg-main.
endif
```
